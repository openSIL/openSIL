## xUSL/NBIO/Kconfig
```kconfig
# Config for  xUSL/NBIO
# Copyright 2023 Advanced Micro Devices, Inc. All rights reserved.
# SPDX-License-Identifier: MIT
#
#

# Kconfig vars used for display control. One for each version.
# These are used in the \konfig.ip file for selecting IP versions.
config HAVE_NBIO_IOD
    bool

# conditional all elements since this IP device may or may not be included
if HAVE_NBIO_IOD
    menu "Northbridge IO (NBIO) Device     "
        comment "The NBIO device comprises multiple IPs that are related to"
        comment "high-speed IO resource."
        source "xUSL/NBIO/IOD/Kconfig"

    endmenu
endif
```

## xUSL/Sdci/Common/Kconfig
```kconfig
# Config for xUSL/Sdci/Common
# Copyright 2023 Advanced Micro Devices, Inc. All rights reserved.
# SPDX-License-Identifier: MIT
#
#

# SDCI common variables:
comment ""
comment "IP SDCI Common - Controls that are common to all versions of the IP: SDCI"

# ------------------------------ Smart Data Cache Injection --------------------------
config SDCI_SMART_DATA_CACHE_INJECTION_ENABLE
    int  "Enable smart data cache injection feature [1/0]"
    default 0
    range 0 1
    help
        Enable or disable smart data cache injection
        feature using SDCI.
```

## xUSL/Sdci/Kconfig
```kconfig
# Kconfig vars used for display control. One for each version.
# These are used in the \konfig.ip file for selecting IP versions.
config HAVE_SDCI
    bool

# conditional all elements since this IP device may or may not be included
if HAVE_SDCI
    menu "Smart Data Cache Injection (SDCI)"
        comment "The SDCI IP adds the capability to"
        comment " perform certain fabric writes directly"
        comment " into cache rather than to the DRAM first."
        source "xUSL/Sdci/Common/Kconfig"

    endmenu
endif
```

## xUSL/XMP/Common/Kconfig
```kconfig
# Config for  xUSL/XMP/Common
# Copyright 2022-2023 Advanced Micro Devices, Inc. All rights reserved.
# SPDX-License-Identifier: MIT
#
#

# XMP common variables:
comment ""
comment "IP XMP Common - Controls that are common to all versions of the IP: XMP"
config XMP_CMN_VARHEX
    hex     "This value is for (XMP_CMN_VARHEX)"
    default 0x00
    help
        This is an example of how to set a config for an IP variable
        common to all versions of the Device. This is used to set
        defaults in the input block for the IP. See XmpClassDflts.c

config XMP_CMN_FEAT1_VAR
    int     "Value for Feature 1"
    default 12
    help
        Used for var: XMP_CMN_FEAT1_VAR

config XMP_CMN_FEAT2_VAR
    int "Value for Feature 2"
    default 34
    help
        Used for var: XMP_CMN_FEAT2_VAR

config XMP_CMN_VAR_TWO
    int "Value for Var2"
    default 56
    help
        Used for var: XMP_CMN_VAR_TWO

config XMP_CMN_FEAT_X_EN
    bool "Value to enable Feature X"
    default n
    help
        Used for var: XMP_CMN_FEAT_X_EN
```

## xUSL/XMP/Kconfig
```kconfig
# Config for  xUSL/XMP
# Copyright 2022-2023 Advanced Micro Devices, Inc. All rights reserved.
# SPDX-License-Identifier: MIT
#
#

# Kconfig vars used for display control. One for each version.
# These are used in the \konfig.ip file for selecting IP versions.
config HAVE_XMP_VER_A
    bool

config HAVE_XMP_VER_B
    bool

# conditional all elements since this IP device may or may not be included
if HAVE_XMP_VER_A || HAVE_XMP_VER_B
    menu "Example (XMP) Device"
        comment "The XMP device is an example for developers"
        comment " Scan this device for ideas on how to implement"
        comment " Kconfig controls for your IP block."
        source "xUSL/XMP/Common/Kconfig"
        source "xUSL/XMP/Ver-A/Kconfig"
        source "xUSL/XMP/Ver-B/Kconfig"

    endmenu
endif
```

## xUSL/XMP/Ver-A/Kconfig
```kconfig
# Config for  xUSL/XMP/Ver-A
# Copyright 2022-2023 Advanced Micro Devices, Inc. All rights reserved.
# SPDX-License-Identifier: MIT
#
#


if HAVE_XMP_VER_A
comment ""
comment "IP: XMP Ver-A  **"
config XMP_A_FEAT_VARINT
    int "Length of some Rev-A item"
    default 2
    range 1 10
    help
        This is a random variable specific to only Version A of the IP.
        PLEASE do not name the variable with the version, use a feature based title.

config XMP_A_FEAT_VARHEX
    hex "Value, e.g. location, of an XMP data element."
    default 0x0000
    help
        This is an example of a hex value field. This is for illustration.
        This variable uses IP and version in the name for clarity of the example.

config XMP_A_FEAT_VARSTR
    string "Name or title of some XMP Feature."
    default "Empty"
    help
        This is an example of a string field. This is for illustration.
        This string is limited to 16 chars in length.

endif
```

## xUSL/XMP/Ver-B/Kconfig
```kconfig
# Config for  xUSL/XMP/Ver-B
# Copyright 2022-2023 Advanced Micro Devices, Inc. All rights reserved.
# SPDX-License-Identifier: MIT
#
#

if HAVE_XMP_VER_B
comment ""
comment "IP: XMP Ver-B is used by F19M10 **"
config XMP_B_VARINT
    int "Some value new to Rev-B of the IP."
    default 5
    help
        This is a random variable specific to only Version B of the IP.
        PLEASE do not name the variable with the version, use a feature based title.
        This variable uses IP and version in the name for clarity of the example.

endif
```
