## Kconfig.IP
```kconfig
# SPDX-License-Identifier: MIT
#
# Copyright (C) 2022 - 2025 Advanced Micro Devices, Inc. All rights reserved.

source "xUSL/CCX/Kconfig"
source "xUSL/Nbio/Kconfig"
source "xUSL/Mpio/Kconfig"
source "xUSL/FCH/Kconfig"
```

## xSIM/SoC/F1AM00/Kconfig
```kconfig
# SPDX-License-Identifier: MIT
# Copyright (C) 2022 - 2025 Advanced Micro Devices, Inc. All rights reserved.
# Config for  xSIM/SoC/F1AM00
#
#

config HAVE_SOC_F1AM00
    bool
#    select ????


if HAVE_SOC_F1AM00
comment "** selected: SoC F1AM00  a.k.a. 'Breithorn' **"
config SOC_F1AM00_FEAT_VAR
    int
    default 2
    help
        This is an SoC descriptor variable. These are loaded to the xSIM
        SoC descriptors memory buffer for use by the IP blocks.

endif
```

## xUSL/CCX/Kconfig
```kconfig
# SPDX-License-Identifier: MIT
# Config for  xUSL/CCX
# Copyright (C) 2022 - 2025 Advanced Micro Devices, Inc. All rights reserved.

  menu "Compute Core Complex (CCX) Device"
    comment "The CCX device controls the quantity and operation of the"
    comment "compute core in the system"

    source "xUSL/CCX/Common/Kconfig"

  endmenu
```

## xUSL/CCX/Zen5/Kconfig
```kconfig
# SPDX-License-Identifier: MIT
# Copyright (C) 2022 - 2025 Advanced Micro Devices, Inc. All rights reserved.
# Config for  xUSL/CCX/Zen5
#
#

if HAVE_CCX_ZEN5
  menu "CCX Zen5 Configuration"
    comment "                                                              "
    comment "CCX Zen5 Configuration                                        "
    comment "                                                              "
    config CCX_ZEN5_VARIANT
      int "Some value new to ZEN5 of the IP."
      default 5
      help
          This is a random variable specific to only Zen5 of the IP.
          PLEASE do not name the variable with the version, use a feature based title.
          This variable uses IP and version in the name for clarity of the example.
  endmenu
endif
```

## xUSL/FCH/Common/FchCore/FchAb/Kconfig
```kconfig
# SPDX-License-Identifier: MIT
# Copyright (C) 2022 - 2025 Advanced Micro Devices, Inc. All rights reserved.
# Config for  xUSL/FCH/Common/FchCore/FchAb
#
#
menu "FCH-AB System Bus interface for FCH"
comment "                                                                "
comment " The AB block is the system bus interface for the sub-components"
comment " located in the FCH. These include clock gating, reset and      "
comment " DMA control options.                                           "
comment "                                                                "

#---------------------- A-Link Clk Gating ---------------------

config FCH_ALINK_CLK_GATING
    int "Enable Clock Gating on the A-Link"
    range 0 1
    default 1
    help
        Gating off a clock when it is not being used can save some
        power in the system. A-link Clock Gate-Off function:
        0:Clk always running,
        1:Clk can be gated off

#---------------------- B-Link Clk Gating ---------------------

config FCH_BLINK_CLK_GATING
    int "Enable Clock Gating on the B-Link"
    range 0 1
    default 1
    help
        Gating off a clock when it is not being used can save some
        power in the system. B-link Clock Gate-Off function:
        0:Clk always running,
        1:Clk can be gated off

#---------------------- AB I/F Clk Gating ---------------------

config FCH_AB_CLK_GATING
    int "Enable Clock Gating on A/B interface"
    range 0 1
    default 1
    help
        This should be enabled when either Alink or Blink gating is enabled
        AB Clock Gating:
        0:disable - clocks run always
        1:enable the gating option

#---------------------- Slow B-Clock ---------------------

config FCH_SLOW_BCLOCK
    int "Use slow B-clock? (save power)"
    range 0 1
    default 0
    help
        Slow down Internal Core Clock (B-Link clock) for power saving
        0:Use full speed clock
        1:Use slow clock

#---------------------- Reset on SyncFlood ---------------------

config FCH_RESET_SYNC_FLOOD
    int "Enable a reset on detecting an error (SyncFlood)?"
    range 0 1
    default 0
    help
        Enable AB to forward downstream sync-flood message to system
        controller.
        1: Forward error to system
        0: Hide downstream errors

#---------------------- DMA Write size  ---------------------

config FCH_DMA_SIZE
    int "Allow DMA sizes of 32 and 64 bytes?"
    range 0 1
    default 1
    help
        Sets the permitted DMA transaction sizes on the AB bus
        0: DMA uses only 16 byte write requests
        1: DMA may use 32 byte and 64 byte writes

#---------------------- AB Mem Pwr Saving ---------------------

config FCH_MEM_PWR_SAVING
    int "Enable power saving during memory idle times?"
    range 0 1
    default 1
    help
        Memory Shutdown feature

#---------------------- SDP Power Saving ---------------------

config FCH_SDP_PWR_SAVING
    int "Enable SDP power savings?"
    range 0 1
    default 1
    help
        Scalable Data Port (SDP) can detect idle conditions and save power
        by doing a 'shutdown' on select interfaces.

#---------------------- SDP Clock Gating ---------------------

config FCH_SDP_CLK_GATING
    int "Enable SDP Clock Gating?"
    range 0 1
    default 1
    help
        Scalable Data Port (SDP) can reduce power by gating clocks when idle.

#---------------------- xDMA Size ---------------------

config FCH_XDMA_LIMIT_SIZE
    int "Limit xDMA sizes to 16 bytes?"
    range 0 1
    default 0
    help
        Sets the permitted xDMA transaction sizes through the AXI Ctlr
        0: xDMA may use 32 byte and 64 byte writes
        1: xDMA uses only 16 byte write requests

#---------------------- xDMA Power Saving ---------------------

config FCH_XDMA_PWR_SAVING
    int "Enable xDMA power savings?"
    range 0 1
    default 0
    help
        xDMA AXI Ctlr can detect idle conditions and save power
        by doing a 'shutdown' on select interfaces.

#---------------------- xDMA NPR Threshold ---------------------

config FCH_XDMA_NPR_COUNT
    int "Count of xDMA non-Posted Requests"
    range 0 31
    default 0
    help
        This is a performance control that can limit the number of non-Posted
        Requests (NPRs) to be outstanding at one time.
        0 = allow max of 32 RPRs
        1..31 = sets a lower limit

#---------------------- xDMA Ordering  ---------------------

config FCH_XDMA_ORDER_DIS
    int "Should the ordering rule for xDMA downstream writes be disabled?"
    range 0 1
    default 0
    help
        The ordering rule of 'downstream Non-posted requests
        completion to flush upstream DMA write' can be disabled.
        0: Rule is enforced
        1: Rule is disabled

#---------------------- SDP Host Bypass ---------------------

config FCH_SDP_BYPASS_PACK
    int "Let SDP Bypass Data Bus packing?"
    range 0 1
    default 0
    help
         Scalable Data Port (SDP) normally pack the data bus to 256 bits.
         This control allows the packing stage to be bypassed.
         0: packing enabled
         1: bypass the packing stage.

#---------------------- SDP NPM WR Interleaving ---------------------

config FCH_SDP_INTERLEAVING
    int "Disable SDP Interleaving protection?"
    range 0 1
    default 0
    help
        Scalable Data Port (SDP) downstream writes are ordered; but that
        can be disabled and allow interleaved writes.
        0: Ordering is enforced
        1: Interleaving is allowed.


#---------------------- next_item ---------------------


endmenu # Sys Bus I/F for FCH
```

## xUSL/FCH/Common/FchCore/FchHwAcpi/Kconfig
```kconfig
# SPDX-License-Identifier: MIT
# Copyright (C) 2021 - 2025 Advanced Micro Devices, Inc. All rights reserved.
# Config for  xUSL/FCH/Common/FchCore/FchHwAci

menu "FCH-ACPI, Power and Misc controls"
comment "The HwAcpi component provides controls for ACPI related items,"
comment "System power options and various platform controls."

#---------------------- Spread Spectrum ---------------------
config SPREAD_SPECTRUM
    int "Enable Spread Spectrum"
    range 0 1
    default 1
    help
        'Spread Spectrum' is a technique used to reduce RF emissions

#---------------------- Power Fail ---------------------
choice
    prompt "After a power failure, what state does the unit go?"
    default CHOICE_PWR_STAY_OFF
    help
        When a power failure occurs the state of the unit is noted.
        Once the local power returns, the unit state can set per this option.

config CHOICE_PWR_STAY_OFF
    bool "Leave the power off"
    help
       Power will remain off. No attempt will be made to restart the unit.

config CHOICE_PWR_ON_UNIT
    bool "Restart the unit."
    help
       After local power is available, simulate a power button press to
       return the unit to full operation.

config CHOICE_PWR_RESTORE
    bool "Restore power to its state prior to the fail."
    help
      If the unit was oprational before the power failed, the unit
      will be restarted when local power is available.
      If the unit was inactive, it will remain off.

endchoice

config POWER_FAIL_RETURN_STATE
    int
    default 0   if CHOICE_PWR_STAY_OFF
    default 1   if CHOICE_PWR_ON_UNIT
    default 3   if CHOICE_PWR_RESTORE
    help
      define the system variable that is used in the code


#---------------------- Stress Reset Mode ---------------------
choice
    prompt "Choose method of reset"
    default CHOICE_STRESS_DISABLE
    help
        When the unit is stressed, how should it be reset?

config CHOICE_STRESS_DISABLE
    bool "Disable any reset action."

config CHOICE_USE_KBD_RESET
    bool "Initiate a KBD reset action"
    help
       A value of 0xFE will be sent to the KBD port (IO 0x64)

config CHOICE_SOFT_RESET
    bool "Use a 'soft' reset"
    help
        A value of 0x06 will be sent to the PCI reset port (IO 0x0CF9)

config CHOICE_HARD_RESET
    bool "Use a 'hard' reset"
    help
        A value of 0x0E will be sent to the PCI reset port (IO 0x0CF9)

endchoice

##  define the system variable that is used in the code
config STRESS_RESET_MODE
    int
    default 0   if CHOICE_STRESS_DISABLE
    default 1   if CHOICE_USE_KBD_RESET
    default 2   if CHOICE_SOFT_RESET
    default 3   if CHOICE_HARD_RESET

#---------------------- Clear Thrm status ---------------------
config CLEAR_THRMTRIP_STATUS
    int "Don't clear the Thermal status on boot? [0/1]"
    range 0 1
    default 0
    help
        Caution: This item employs Double Negative logic
        Value of false (0) will cause the status bit to be cleared.

#---------------------- Boot Timer ---------------------
config ENABLE_BOOT_TIMER
    int "Enable the system Boot Timer? [0/1]"
    range 0 1
    default 0
    help
        Choose to activate the Boot Timer. When active, an expired timer will
        cause a system reset.

config BOOT_TIMER_RESET
    int "Choose the Reset Type (0-warm, 1-cold)"
    range 0 1
    default 0
    help
        IF the Boot Timer is enabled, then this item controls the type of reset
        to be use when the timer expires.
        value =0 (false) the reset will be a 'warm reset'
        value =1 (true) the reset will be a 'cold reset'

#---------------------- Toggle AllPwrGood on CF9 ---------------------
config TOGGLE_ALL_PWRGOOD
    int "On CF9 reset, use all reset signals"
    range 0 1
    default 0
    help
        When a 0x0CF9 IO register write is used to reset the system,
        most or all of the reset signals are toggled.
        Value =0 (false) most of the resets are toggled
        Value =1 (true) all of the resets are toggled.

#---------------------- Monitor DIMM Telemetry ---------------------
config DIMM_TELEMETRY
    int "Enable DIMM monitoring? [0/1]"
    range 0 1
    default 0
    help
        Some DIMMs provide telemetry to track thermal status, or other measurements.
        Value =0 (false) No monitoring is performed
        Value =1 (true) The SMU is instructed to perform DIMM monitoring.

endmenu #  FCH ACPI, Power, Misc
```
