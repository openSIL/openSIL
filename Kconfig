## xUSL/FCH/Common/FchCore/FchIsa/Kconfig
```kconfig
# SPDX-License-Identifier: MIT
# Copyright (C) 2022 - 2025 Advanced Micro Devices, Inc. All rights reserved.
# Config for  xUSL/FCH/Common/FchCore/FchIsa
#
#

menu "FCH-ISA Bus interface for FCH"
comment "                                                      "
comment " The ISA bus is a legacy system bus for devices       "
comment " such as: LPC, SPI, TPM.                              "
comment "                                                      "

menu "LPC Bus Configurations"
#---------------------- next_item ---------------------

config LPC_BUS_ENABLE
    int "Activate the LPC Bus?"
    range 0 1
    default 1
    help
        The Low-Pin-Count (LPC) bus is a legacy bus used for
        devices like the SPI flash ROM, and TPM.

endmenu

# *****************************************************
menu "SPI Bus Configurations"
#---------------------- Standard SPEED ---------------------

choice CHOICE_SPI_STD_SPEED
    prompt "SPI bus Speed for standard accesses"
    default CHOICE_33MHZ_STD
    help
        For SPI bus accesses directed to the STD device,
        this is the transaction speed to be used.

config CHOICE_IGNORE_STDSPEED
    bool "Don't touch. Use value set by the HW/FW"
    help
        The speed was set by either hardware power-on default
        or the embedded firmware. Do not change the setting.

config CHOICE_66MHZ_STD
    bool "66MHz standard speed"
    help
        Set the bus speed for using a 66MHz clock.

config CHOICE_50MHZ_STD
    bool "50MHz standard speed"

config CHOICE_33MHZ_STD
    bool "33MHz standard speed"

config CHOICE_22MHZ_STD
    bool "22MHz standard speed"

config CHOICE_16_5MHZ_STD
    bool "16.5MHz standard speed"

config CHOICE_4MHZ_STD
    bool "4MHz standard speed"

config CHOICE_800KHZ_STD
    bool "800Khz standard speed"

config CHOICE_100KHZ_STD
    bool "100KHz standard speed"

endchoice

##  define the system variable that is used in the code
config SPI_STD_SPEED
    int
    default 0   if CHOICE_IGNORE_STDSPEED
    default 1   if CHOICE_66MHZ_STD
    default 2   if CHOICE_33MHZ_STD
    default 3   if CHOICE_22MHZ_STD
    default 4   if CHOICE_16_5MHZ_STD
    default 5   if CHOICE_100KHZ_STD
    default 6   if CHOICE_800KHZ_STD
    default 7   if CHOICE_50MHZ_STD
    default 8   if CHOICE_4MHZ_STD

#---------------------- Write SPEED ---------------------

choice CHOICE_SPI_WRT_SPEED
    prompt "SPI bus Speed for standard accesses"
    default CHOICE_IGNORE_WRTSPEED
    help
        For SPI bus accesses directed to the WRT device,
        this is the transaction speed to be used.

config CHOICE_IGNORE_WRTSPEED
    bool "Don't touch. Use value set by the HW/FW"
    help
        The speed was set by either hardware power-on default
        or the embedded firmware. Do not change the setting.

config CHOICE_66MHZ_WRT
    bool "66MHz standard speed"
    help
        Set the bus speed for using a 66MHz clock.

config CHOICE_50MHZ_WRT
    bool "50MHz standard speed"

config CHOICE_33MHZ_WRT
    bool "33MHz standard speed"

config CHOICE_22MHZ_WRT
    bool "22MHz standard speed"

config CHOICE_16_5MHZ_WRT
    bool "16.5MHz standard speed"

config CHOICE_4MHZ_WRT
    bool "4MHz standard speed"

config CHOICE_800KHZ_WRT
    bool "800Khz standard speed"

config CHOICE_100KHZ_WRT
    bool "100KHz standard speed"

endchoice

##  define the system variable that is used in the code
config SPI_WRT_SPEED
    int
    default 0   if CHOICE_IGNORE_WRTSPEED
    default 1   if CHOICE_66MHZ_WRT
    default 2   if CHOICE_33MHZ_WRT
    default 3   if CHOICE_22MHZ_WRT
    default 4   if CHOICE_16_5MHZ_WRT
    default 5   if CHOICE_100KHZ_WRT
    default 6   if CHOICE_800KHZ_WRT
    default 7   if CHOICE_50MHZ_WRT
    default 8   if CHOICE_4MHZ_WRT

#---------------------- TPM SPEED ---------------------

choice CHOICE_SPI_TPM_SPEED
    prompt "SPI bus Speed for TPM accesses"
    default CHOICE_IGNORE_TPMSPEED
    help
        For SPI bus accesses directed to the TPM device,
        this is the transaction speed to be used.

config CHOICE_IGNORE_TPMSPEED
    bool "Don't touch. Use value set by the HW/FW"
    help
        The speed was set by either hardware power-on default
        or the embedded firmware. Do not change the setting.

config CHOICE_66MHZ_TPM
    bool "66MHz TPM speed"
    help
        Set the bus speed for using a 66MHz clock.

config CHOICE_50MHZ_TPM
    bool "50MHz TPM speed"

config CHOICE_33MHZ_TPM
    bool "33MHz TPM speed"

config CHOICE_22MHZ_TPM
    bool "22MHz TPM speed"

config CHOICE_16_5MHZ_TPM
    bool "16.5MHz TPM speed"

config CHOICE_4MHZ_TPM
    bool "4MHz TPM speed"

config CHOICE_800KHZ_TPM
    bool "800Khz TPM speed"

config CHOICE_100KHZ_TPM
    bool "100KHz TPM speed"

endchoice

##  define the system variable that is used in the code
config SPI_TPM_SPEED
    int
    default 0   if CHOICE_IGNORE_TPMSPEED
    default 1   if CHOICE_66MHZ_TPM
    default 2   if CHOICE_33MHZ_TPM
    default 3   if CHOICE_22MHZ_TPM
    default 4   if CHOICE_16_5MHZ_TPM
    default 5   if CHOICE_100KHZ_TPM
    default 6   if CHOICE_800KHZ_TPM
    default 7   if CHOICE_50MHZ_TPM
    default 8   if CHOICE_4MHZ_TPM

endmenu  # SPI bus
#---------------------- next_item ---------------------


endmenu # ISA Bus (LPC & SPI) for FCH
```

## xUSL/FCH/Common/Kconfig
```kconfig
# SPDX-License-Identifier: MIT
# Copyright (C) 2021 - 2025 Advanced Micro Devices, Inc. All rights reserved.
# Config for  xUSL/FCH/Common
#

source "xUSL/FCH/Common/FchCore/*/Kconfig"
```

## xUSL/FCH/Kunlun/Kconfig
```kconfig
# SPDX-License-Identifier: MIT
# Copyright (C) 2022 - 2025 Advanced Micro Devices, Inc. All rights reserved.
#
# Config for  xUSL/FCH/Kunlun
#

if HAVE_FCH_KUNLUN

 # nothing at this level at this time

    source "xUSL/FCH/Kunlun/FchCore/*/Kconfig"
endif
```

## xUSL/FCH/Tacoma/Kconfig
```kconfig
# SPDX-License-Identifier: MIT
# Copyright (C) 2021 - 2025 Advanced Micro Devices, Inc. All rights reserved.
# Config for  xUSL/FCH/Tacoma

source "xUSL/FCH/Tacoma/FchCore/*/Kconfig"
```

## xUSL/Mpio/Kconfig
```kconfig
# SPDX-License-Identifier: MIT
# Copyright (C) 2022 - 2025 Advanced Micro Devices, Inc. All rights reserved.
# Config for  xUSL/MPIO

menu "MicroProcessor Input Output (MPIO)"
    comment "The MPIO IP controls the microprocessor for NBIO"
    comment "firmware/management"

    source "xUSL/Mpio/Common/Kconfig"
    source "xUSL/Mpio/Phx/Kconfig"

endmenu
```

## xUSL/Mpio/Phx/Kconfig
```kconfig
# SPDX-License-Identifier: MIT
# Config for  xUSL/Mpio/Phx
# Copyright (C) 2024 - 2025 Advanced Micro Devices, Inc. All rights reserved.
#
#

# MPIO Phx variables:
comment ""
comment "IP MPIO Phx - Controls that are specific to Phx: MPIO"

# ------------------------------ MPIO PSPP Configuration --------------------------
choice
    prompt  "Socket number for connecting the BMC link"
    default CHOICE_PSPP_DISABLED
    help
        Define the initial PSPP configuration.
        Ref: typedef enum{} MPIO_PSPP_MODE;

config  CHOICE_PSPP_DISABLED
    bool "PSPP is disabled"
    help
        PSPP is disabled in this mode.

config  CHOICE_PERFORMANCE_MODE
    bool "PSPP Performance Mode"
    help
        PSPP configured to use the Performance Mode.

config  CHOICE_BALANCED_MODE
    bool "PSPP Balanced Mode"
    help
        PSPP configured to use the Balanced Mode

config  CHOICE_POWER_SAVING_MODE
    bool "PSPP Power Saving Mode"
    help
        PSPP configured to use the Power Saving Mode

endchoice

##  define the system variable that is used in the code
config MPIO_PSPP_MODE
    hex
    default  0x00      if CHOICE_PSPP_DISABLED
    default  0x01      if CHOICE_PERFORMANCE_MODE
    default  0x02      if CHOICE_BALANCED_MODE
    default  0x03      if CHOICE_POWER_SAVING_MODE

# ------------------------------ Subsystem ID for Root Controllers --------------------------
config NBIF_RC_SSID
    hex  "Define the subsystem ID assigned to root controllers [0-FFFFFFFF]"
    default 0x00000000
    range 0 0xFFFFFFFF
    help
        This 32-bit value is used to define the subsystem ID
        assigned to the root controllers. The default power-up
        setting for NBIF RC SSID is 0.

# ------------------------------ AmdCfgGnbIGPUSSID --------------------------
config GNB_IGPU_SSID
    hex  "Gnb IGPU SSID [0-FFFFFFFF]"
    default 0x00000000
    range 0 0xFFFFFFFF
    help
        This 32-bit value is used to define the Gnb iGPU SSID.
        The default setting is 0.

# ------------------------------ PCI Sub-System ID --------------------------
config GNB_IGPU_AUDIO_SSID
    hex  "Define the subsystem ID assigned to root controllers [0-FFFFFFFF]"
    default 0x00000000
    range 0 0xFFFFFFFF
    help
        This 32-bit value allows the host BIOS to set the PCI
        subsystem ID reported by the iGPU audio controller.
        This is nBIF Function 1 for Family 17h processors. A
        value of zero indicates that the normal hardware fused
        value should be used.

# ------------------------------ Enable ACP Controller --------------------------
config MPIO_ACP_CONTROLLER_ENABLE
    int  "Enable ACP controller [1/0]"
    default 1
    range 0 1
    help
        This value enables or disables ACP controller
        behind nbif.

# ------------------------------ Enable Sensor Hub --------------------------
config MPIO_SENSOR_HUB_ENABLE
    int  "Enable Sensor Hub [1/0]"
    default 1
    range 0 1
    help
        This value enables or disables the nBIF device
        for MP2.

# ------------------------------ Enable NBIO HD Audio Device --------------------------
config MPIO_HD_AUDIO_DEV_ENABLE
    int  "Enable NBIO high definition audio device [1/0]"
    default 1
    range 0 1
    help
        This value selects whether or not the whether or not the
        NBIO high definition audio device is active.

# ------------------------------ ACP Sub-System ID --------------------------
config MPIO_ACP_SSID
    hex  "Assign the ACP SSID [0-FFFFFFFF]"
    default 0x00000000
    range 0 0xFFFFFFFF
    help
        This 32-bit value allows assignment of ACP SSID.

# ------------------------------ Prevent Entering Loopback Mode --------------------------
config MPIO_LOOPBACK_CONTROL
    hex  "Disable root port from entering loopback mode [1/0]"
    default 1
    range 0 1
    help
        This configuration option enables a user to prevent
        the root port from entering loopback mode. Setting
        the value to 1 will allow the root port to enter
        loopback mode. The default value of this configuration
        is 1.

# ------------------------------ MPIO Data Link Feature Enablement V2 --------------------------
config MPIO_DLF_CAP_ENABLE_V2
    int  "Enable Data Link Feature capability [1/0]"
    default 15
    range 0 255
    help
        Used to enable MPIO Data Link Feature capability
        on all PCIe ports Gen4 or higher.

# ------------------------------ MPIO Data Link Feature Exchange Enablement V2 --------------------------
config MPIO_DLF_EX_ENABLE_V2
    int  "Enable Data Link Feature Exchange capability [1/0]"
    default 15
    range 0 255
    help
        Used to enable MPIO Data Link Feature Exchange
        capability on all PCIe ports Gen4 or higher.

# ------------------------------ MPIO 10-bit Tag Support --------------------------
config MPIO_PCIE_TBT_SUPPORT_ENABLE
    int  "Enable 10-bit tag support [1/0]"
    default 1
    range 0 1
    help
        Used to enable 10-bit tag for devices that indicate
        support.

# ------------------------------ MPIO Access Control Services (ACS) Enablement --------------------------
config MPIO_CFG_ACS_ENABLE
    int  "Enable Access Control Services [1/0]"
    default 1
    range 0 1
    help
        Used to enable Access Control Services. Setting this
        value to 1 will enable ACS.

# ------------------------------ CfgPCIeLTREnable --------------------------
config PCIE_LTR_ENABLE
    int  "LTR enable [1/0]"
    default 1
    range 0 1

# ------------------------------ PcieEcrcEnablement --------------------------
config PCIE_ECRC_ENABLE
    int  "ECRC enable [1/0]"
    default 0
    range 0 1
```

## xUSL/Nbio/Kconfig
```kconfig
# SPDX-License-Identifier: MIT
# Config for  xUSL/Nbio
# Copyright (C) 2023 - 2025 Advanced Micro Devices, Inc. All rights reserved.

menu "Northbridge IO (NBIO) Device"
    comment "The NBIO device comprises multiple IPs that are related to"
    comment "high-speed IO resource, primarily the PCI Express"
    comment "and internal graphics subsystems"

    source "xUSL/Nbio/Phx/Kconfig"
endmenu
```

## xUSL/Sdxi/Common/Kconfig
```kconfig
# SPDX-License-Identifier: MIT
# Copyright (C) 2023 - 2025 Advanced Micro Devices, Inc. All rights reserved.
# Config for xUSL/Sdxi/Common
#
#

# SDXI common variables:
comment ""
comment "IP SDXI Common - Controls that are common to all versions of the IP: SDXI"

# ------------------------------ Smart Data Cache Injection --------------------------
config SDXI_SMART_DATA_CACHE_INJECTION_ENABLE
    int  "Enable smart data cache injection feature [1/0]"
    default 0
    range 0 1
    help
        Enable or disable smart data cache injection
        feature using SDXI.
```
